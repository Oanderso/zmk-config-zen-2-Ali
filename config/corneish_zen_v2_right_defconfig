## config/corneish_zen_v2_right_defconfig
```kconfig
#
# Copyright (c) 2022 Darryl deHaan
# SPDX-License-Identifier: MIT
#

CONFIG_SOC_SERIES_NRF52X=y
CONFIG_SOC_NRF52840_QIAA=y
CONFIG_BOARD_CORNEISH_ZEN_V2_RIGHT=y
CONFIG_ZMK_SLEEP=y
CONFIG_BOARD_ENABLE_DCDC=y
CONFIG_BOARD_ENABLE_DCDC_HV=y

CONFIG_ARM_MPU=y
CONFIG_PINCTRL=y
CONFIG_GPIO=y

# Azoteq TPS43 / IQS5xx touchpad.
CONFIG_I2C=y
CONFIG_I2C_NRFX=y
CONFIG_INPUT=y
CONFIG_INPUT_AZOTEQ_IQS5XX=y
CONFIG_ZMK_POINTING=y
CONFIG_ZMK_MOUSE=y

# WS2812 underglow remains on SPI3.
CONFIG_SPI_NRFX=y

CONFIG_USE_DT_CODE_PARTITION=y
CONFIG_BUILD_OUTPUT_UF2=y
CONFIG_MPU_ALLOW_FLASH_WRITE=y
CONFIG_NVS=y
CONFIG_SETTINGS_NVS=y
CONFIG_FLASH=y
CONFIG_FLASH_PAGE_LAYOUT=y
CONFIG_FLASH_MAP=y

CONFIG_CLOCK_CONTROL_NRF_K32SRC_XTAL=y
CONFIG_CLOCK_CONTROL_NRF_K32SRC_30PPM=y

# Right is the host-facing central half.
CONFIG_ZMK_SPLIT_ROLE_CENTRAL=y
CONFIG_ZMK_USB=y
CONFIG_ZMK_BLE=y

# The right e-ink display is physically removed.
CONFIG_ZMK_DISPLAY=n

CONFIG_ZMK_EXT_POWER=y
CONFIG_ZMK_BLE_PASSKEY_ENTRY=n
CONFIG_ZMK_BLE_CLEAR_BONDS_ON_START=n
CONFIG_USB_DEVICE_MANUFACTURER="corne_epd"
CONFIG_BT_CTLR_TX_PWR_PLUS_8=y
CONFIG_ZMK_HID_REPORT_TYPE_NKRO=n
```

## local-modules/tps43-release-inertia/dts/bindings/zmk,input-processor-release-inertia.yaml
```yaml
description: Cursor glide gated by explicit TPS43 finger contact
compatible: "zmk,input-processor-release-inertia"
include: ip_zero_param.yaml
properties:
  report-interval-ms:
    type: int
    default: 20
  release-window-ms:
    type: int
    default: 80
  start-threshold:
    type: int
    default: 3
  stop-threshold:
    type: int
    default: 1
  retention-percent:
    type: int
    default: 90
```

## modules/tps43-release-inertia/Kconfig
```kconfig
rsource "drivers/input/Kconfig"

config ZMK_INPUT_PROCESSOR_RELEASE_INERTIA
    bool
    default y if DT_HAS_ZMK_INPUT_PROCESSOR_RELEASE_INERTIA_ENABLED
    depends on ZMK_POINTING && ZMK_SPLIT_ROLE_CENTRAL
```
